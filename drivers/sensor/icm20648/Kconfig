## drivers/sensor/icm20648/Kconfig
```kconfig
# ICM20648 Six-Axis Motion Tracking device configuration options

# Copyright (c) 2022 Tal Risin
# SPDX-License-Identifier: Apache-2.0

menuconfig ICM20648
	bool "ICM20648 Six-Axis Motion Tracking Device"
	depends on SPI
	help
	  Enable driver for ICM20648 SPI-based six-axis motion tracking device.

if ICM20648

endif # ICM20648
```

## dts/bindings/sensor/invensense,icm20648.yaml
```yaml
# Copyright (c) 2022 Tal Risin
# SPDX-License-Identifier: Apache-2.0

description: ICM-20648 motion tracking device

# ICM-20648 is SPI.
compatible: "invensense,icm20648"

include: spi-device.yaml

properties:
    int-gpios:
      type: phandle-array
      required: true
      description: |
        The INT signal default configuration is active-high.  The
        property value should ensure the flags properly describe the
        signal that is presented to the driver.
```
